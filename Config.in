## Config.in
```kconfig
source "$BR2_EXTERNAL_NFC_TERMINAL_PATH/package/st7703-gx040hd/Config.in"
source "$BR2_EXTERNAL_NFC_TERMINAL_PATH/package/libnfc-nci/Config.in"
source "$BR2_EXTERNAL_NFC_TERMINAL_PATH/package/pn5xx-i2c/Config.in"
```

## configs/nfc_terminal_cm4_defconfig
```kconfig
BR2_aarch64=y
BR2_cortex_a72=y
BR2_ARM_FPU_VFPV4=y
BR2_TOOLCHAIN_BUILDROOT_CXX=y
BR2_TARGET_GENERIC_HOSTNAME="nfc-terminal"
BR2_TARGET_GENERIC_ISSUE="NFC Terminal - Raspberry Pi CM4"
BR2_ROOTFS_DEVICE_CREATION_DYNAMIC_EUDEV=y
BR2_TARGET_GENERIC_ROOT_PASSWD="nfc-terminal"
BR2_SYSTEM_DHCP="eth0"
BR2_ROOTFS_POST_BUILD_SCRIPT="$(BR2_EXTERNAL_NFC_TERMINAL_PATH)/board/nfc-terminal/post-build.sh"
BR2_ROOTFS_POST_IMAGE_SCRIPT="$(BR2_EXTERNAL_NFC_TERMINAL_PATH)/board/nfc-terminal/post-image.sh"
BR2_LINUX_KERNEL=y
BR2_LINUX_KERNEL_CUSTOM_GIT=y
BR2_LINUX_KERNEL_CUSTOM_REPO_URL="https://github.com/raspberrypi/linux.git"
BR2_LINUX_KERNEL_CUSTOM_REPO_VERSION="rpi-6.12.y"
BR2_LINUX_KERNEL_DEFCONFIG="bcm2711"
BR2_LINUX_KERNEL_CONFIG_FRAGMENT_FILES="$(BR2_EXTERNAL_NFC_TERMINAL_PATH)/board/nfc-terminal/linux.config.fragment"
BR2_LINUX_KERNEL_DTS_SUPPORT=y
BR2_LINUX_KERNEL_INTREE_DTS_NAME="broadcom/bcm2711-rpi-cm4"
BR2_LINUX_KERNEL_NEEDS_HOST_OPENSSL=y
BR2_PACKAGE_BUSYBOX_SHOW_OTHERS=y
BR2_PACKAGE_XZ=y
BR2_PACKAGE_FBV=y
BR2_PACKAGE_RPI_FIRMWARE=y
BR2_PACKAGE_RPI_FIRMWARE_VARIANT_PI4=y
BR2_PACKAGE_RPI_FIRMWARE_CONFIG_FILE="$(BR2_EXTERNAL_NFC_TERMINAL_PATH)/board/nfc-terminal/config.txt"
BR2_PACKAGE_I2C_TOOLS=y
BR2_PACKAGE_LIBGPIOD=y
BR2_PACKAGE_LIBGPIOD_TOOLS=y
BR2_PACKAGE_DROPBEAR=y
BR2_PACKAGE_ETHTOOL=y
BR2_PACKAGE_IPROUTE2=y
BR2_PACKAGE_HTOP=y
BR2_PACKAGE_KMOD_TOOLS=y
BR2_PACKAGE_NANO=y
BR2_TARGET_ROOTFS_EXT2=y
BR2_TARGET_ROOTFS_EXT2_4=y
BR2_TARGET_ROOTFS_EXT2_SIZE="512M"
# BR2_TARGET_ROOTFS_TAR is not set
BR2_PACKAGE_HOST_DOSFSTOOLS=y
BR2_PACKAGE_HOST_GENIMAGE=y
BR2_PACKAGE_HOST_MTOOLS=y
BR2_PACKAGE_HOST_RASPBERRYPI_USBBOOT=y
BR2_PACKAGE_ST7703_GX040HD=y
BR2_PACKAGE_LIBNFC_NCI=y
BR2_PACKAGE_PN5XX_I2C=y
```

## package/nfc-lvgl-app/Config.in
```kconfig
config BR2_PACKAGE_NFC_LVGL_APP
	bool "nfc-lvgl-app"
	depends on BR2_TOOLCHAIN_HAS_THREADS
	select BR2_PACKAGE_LIBNFC_NCI
	select BR2_PACKAGE_LIBDRM
	select BR2_PACKAGE_PAHO_MQTT_C
	help
	  NFC check-in/check-out demo application with LVGL graphical UI.
	  Displays Role A/B buttons and shows NFC tag IDs when cards are detected.

	  https://github.com/dotstartech/nfc-terminal-image

if BR2_PACKAGE_NFC_LVGL_APP

config BR2_PACKAGE_NFC_LVGL_APP_AUTOSTART
	bool "auto-start on tty1"
	default y
	help
	  Start nfc-lvgl-app automatically on tty1 (the display).

endif
```

## package/pn5xx-i2c/Config.in
```kconfig
config BR2_PACKAGE_PN5XX_I2C
	bool "pn5xx-i2c"
	depends on BR2_LINUX_KERNEL
	help
	  NXP PN54x/PN7150 NFC kernel I2C driver.
	  Creates /dev/pn544 character device for userspace NFC stack.

	  This driver handles GPIO control for the NFC chip's
	  enable and interrupt pins via device tree configuration.

	  https://github.com/NXPNFCLinux/nxp-pn5xx

comment "pn5xx-i2c needs a Linux kernel to be built"
	depends on !BR2_LINUX_KERNEL
```

## package/st7703-gx040hd/Config.in
```kconfig
config BR2_PACKAGE_ST7703_GX040HD
	bool "st7703-gx040hd"
	depends on BR2_LINUX_KERNEL
	help
	  Linux kernel module and device tree overlays for the
	  GX040HD-30MB-A1 4.0" 720x720 IPS LCD panel with
	  Sitronix ST7703 display controller and FocalTech FT6336U
	  touch controller.

	  Designed for Raspberry Pi Compute Module 4.

	  https://github.com/dotstartech/st7703-gx040hd-driver

comment "st7703-gx040hd needs a Linux kernel to be built"
	depends on !BR2_LINUX_KERNEL
```
