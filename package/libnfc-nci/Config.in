## package/libnfc-nci/Config.in
```kconfig
config BR2_PACKAGE_LIBNFC_NCI
	bool "libnfc-nci"
	depends on BR2_TOOLCHAIN_HAS_THREADS
	select BR2_PACKAGE_OPENSSL
	help
	  Linux NFC stack for NCI based NXP NFC Controllers.
	  Version NCI2.0-R1.1 supports PN7160 (NCI 2.0).

	  https://github.com/NXPNFCLinux/linux_libnfc-nci

if BR2_PACKAGE_LIBNFC_NCI

config BR2_PACKAGE_LIBNFC_NCI_DEMOAPP
	bool "install demoApp"
	default y
	help
	  Install the NFC demo application for testing NFC functionality.

config BR2_PACKAGE_LIBNFC_NCI_DEMOAPP_AUTOSTART
	bool "auto-start demoApp in poll mode"
	default n
	depends on BR2_PACKAGE_LIBNFC_NCI_DEMOAPP
	help
	  Automatically start demoApp in poll mode at boot to read NFC cards.
	  Note: Not needed if using nfc-console on tty1 for display output.

endif
```

## package/nxpnfc/Config.in
```kconfig
config BR2_PACKAGE_NXPNFC
	bool "nxpnfc"
	depends on BR2_LINUX_KERNEL
	help
	  NXP PN7160 NFC kernel I2C driver (official NXPNFCLinux/nxpnfc).
	  Creates /dev/nxpnfc character device for the libnfc-nci NCI2.0
	  userspace stack. Handles VEN/IRQ/DWL_REQ GPIO control via
	  device tree configuration.

	  https://github.com/NXPNFCLinux/nxpnfc

comment "nxpnfc needs a Linux kernel to be built"
	depends on !BR2_LINUX_KERNEL
```
